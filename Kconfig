## Kconfig
```kconfig
config UAVCAN_ENABLE
    bool "Enable UAVCAN support"
    default n
    depends on CAN
    help
      Enable UAVCAN protocol support (requires CAN bus support)


config CANOPEN_NODE_ID
	int "CANopen node ID"
	default 10
	range 1 127
	help
	  7-bit CANopen Node ID
```
